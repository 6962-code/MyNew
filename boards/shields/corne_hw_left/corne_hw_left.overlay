#include "corne_hw.dtsi"

/ {
    chosen {
        zmk,kscan = &kscan0;
        zmk,matrix-transform = &default_transform;
    };
    physical_layout_6x6: physical_layout_6x6 {
        compatible = "zmk,physical-layout";
        display-name = "My 6x6 Layout";
        transform = <&default_transform>;
        kscan = <&kscan0>;
    };
};

&kscan0 {
    diode-direction = "row2col";

    row-gpios = <&gpio0 22 GPIO_ACTIVE_HIGH>,
                <&gpio0 24 GPIO_ACTIVE_HIGH>,
                <&gpio1 0  GPIO_ACTIVE_HIGH>,
                <&gpio0 11 GPIO_ACTIVE_HIGH>,
                <&gpio1 4  GPIO_ACTIVE_HIGH>,
                <&gpio1 6  GPIO_ACTIVE_HIGH>;

    col-gpios = <&gpio0 2  (GPIO_ACTIVE_HIGH | GPIO_PULL_DOWN)>,
                <&gpio1 15 (GPIO_ACTIVE_HIGH | GPIO_PULL_DOWN)>,
                <&gpio1 13 (GPIO_ACTIVE_HIGH | GPIO_PULL_DOWN)>,
                <&gpio1 11 (GPIO_ACTIVE_HIGH | GPIO_PULL_DOWN)>,
                <&gpio0 10 (GPIO_ACTIVE_HIGH | GPIO_PULL_DOWN)>,
                <&gpio0 9  (GPIO_ACTIVE_HIGH | GPIO_PULL_DOWN)>;
};